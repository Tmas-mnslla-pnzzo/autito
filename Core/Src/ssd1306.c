#include "ssd1306.h"
#include <string.h>

// ── Font 6x8 (ASCII 32..126) ──────────────────────────────
// Cada caracter ocupa 6 bytes (5 columnas de pixels + 1 columna vacia de separacion).
// Los bits representan pixels de arriba (bit0) hacia abajo (bit7).
static const uint8_t font6x8[][6] = {
    {0x00,0x00,0x00,0x00,0x00,0x00}, // ' '
    {0x00,0x00,0x5F,0x00,0x00,0x00}, // '!'
    {0x00,0x07,0x00,0x07,0x00,0x00}, // '"'
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    {0x10,0x08,0x08,0x10,0x08,0x00}, // '~'
};

// ── Secuencia de inicializacion SSD1306 ───────────────────
static const uint8_t init_cmds[] = {
    0xAE,       // display off
    0xD5,0x80,  // clock
    0xA8,0x3F,  // multiplex
    0xD3,0x00,  // display offset
    0x40,       // start line
    0x8D,0x14,  // charge pump
    0xAD,0x8B,  // interno VCC
    0xA1,       // segment remap
    0xC8,       // COM scan remapped
    0xDA,0x12,  // COM pins
    0x81,0xCF,  // contraste
    0xD9,0xF1,  // pre-charge
    0xDB,0x40,  // VCOMH
    0xA4,       // display from RAM
    0xA6,       // normal display
    0xAF,       // display on
};

// ── Helpers internos ──────────────────────────────────────
static void send_cmd(SSD1306_t *dev, uint8_t cmd) {
    uint8_t buf[2] = {0x00, cmd};  // 0x00 = Co=0, D/C=0 (comando)
    dev->i2c_write(dev->addr, buf, 2);
}

static void send_data(SSD1306_t *dev, const uint8_t *data, uint16_t len) {
    // El byte de control 0x40 indica que los siguientes bytes son datos de RAM
    // Mandamos en trozos de 32 bytes para no exceder buffers I2C pequenos
    uint8_t tmp[33];
    tmp[0] = 0x40;
    uint16_t i = 0;
    while (i < len) {
        uint8_t chunk = (len - i) > 32 ? 32 : (uint8_t)(len - i);
        for (uint8_t j = 0; j < chunk; j++) tmp[j+1] = data[i+j];
        dev->i2c_write(dev->addr, tmp, chunk + 1);
        i += chunk;
    }
}

// ── API publica ───────────────────────────────────────────
void SSD1306_Init(SSD1306_t *dev, ssd1306_i2c_write_cb_t i2c_write, uint8_t addr) {
    dev->i2c_write = i2c_write;
    dev->addr      = addr;
    dev->dirty     = 0;
    memset(dev->buf, 0, SSD1306_BUF_SIZE);

    for (uint8_t i = 0; i < sizeof(init_cmds); i++)
        send_cmd(dev, init_cmds[i]);
}

void SSD1306_Clear(SSD1306_t *dev) {
    memset(dev->buf, 0, SSD1306_BUF_SIZE);
    dev->dirty = 1;
}

void SSD1306_DrawPixel(SSD1306_t *dev, uint8_t x, uint8_t y, uint8_t color) {
    if (x >= SSD1306_WIDTH || y >= SSD1306_HEIGHT) return;
    uint16_t idx = x + (y / 8) * SSD1306_WIDTH;
    if (color) dev->buf[idx] |=  (1 << (y % 8));
    else       dev->buf[idx] &= ~(1 << (y % 8));
    dev->dirty = 1;
}

void SSD1306_DrawChar(SSD1306_t *dev, uint8_t col, uint8_t row, char c, uint8_t color) {
    if (c < 32 || c > 126) c = '?';
    const uint8_t *glyph = font6x8[c - 32];
    uint8_t px = col * 6;
    uint8_t py = row * 8;
    for (uint8_t i = 0; i < 6; i++) {
        uint8_t column = glyph[i];
        for (uint8_t j = 0; j < 8; j++) {
            SSD1306_DrawPixel(dev, px + i, py + j, color ? (column >> j) & 1 : !((column >> j) & 1));
        }
    }
}

void SSD1306_DrawText(SSD1306_t *dev, uint8_t col, uint8_t row, const char *str, uint8_t color) {
    while (*str) {
        SSD1306_DrawChar(dev, col++, row, *str++, color);
        if (col >= 21) { col = 0; row++; }  // wrap al ancho maximo
        if (row >= 8) break;
    }
}

void SSD1306_DrawNumber(SSD1306_t *dev, uint8_t col, uint8_t row, uint32_t num, uint8_t color) {
    char buf[12];
    uint8_t i = 0;
    if (num == 0) { buf[i++] = '0'; }
    else {
        uint32_t tmp = num;
        while (tmp > 0) { buf[i++] = '0' + (tmp % 10); tmp /= 10; }
        // invertir
        for (uint8_t a = 0, b = i-1; a < b; a++, b--) {
            char t = buf[a]; buf[a] = buf[b]; buf[b] = t;
        }
    }
    buf[i] = '\0';
    SSD1306_DrawText(dev, col, row, buf, color);
}

void SSD1306_DrawNumberSigned(SSD1306_t *dev, uint8_t col, uint8_t row, int32_t num, uint8_t color) {
    if (num < 0) {
        SSD1306_DrawChar(dev, col++, row, '-', color);
        SSD1306_DrawNumber(dev, col, row, (uint32_t)(-num), color);
    } else {
        SSD1306_DrawNumber(dev, col, row, (uint32_t)num, color);
    }
}

void SSD1306_Update(SSD1306_t *dev) {
    for (uint8_t page = 0; page < SSD1306_PAGES; page++) {
        send_cmd(dev, 0xB0 | page);  // set page
        send_cmd(dev, 0x02);         // columna baja (offset 2 para SH1106)
        send_cmd(dev, 0x10);         // columna alta
        send_data(dev, &dev->buf[page * SSD1306_WIDTH], SSD1306_WIDTH);
    }
    dev->dirty = 0;
}

void SSD1306_UpdatePage(SSD1306_t *dev, uint8_t page) {
    if (page >= SSD1306_PAGES) return;
    send_cmd(dev, 0xB0 | page);    // set page address
    send_cmd(dev, 0x00);           // columna baja = 0
    send_cmd(dev, 0x10);           // columna alta = 0
    send_data(dev, &dev->buf[page * SSD1306_WIDTH], SSD1306_WIDTH);
}
